## Documentation/devicetree/bindings/dma/ti/ti,am62l-dmss-pktdma.yaml
```yaml
# SPDX-License-Identifier: (GPL-2.0-only OR BSD-2-Clause)
# Copyright (C) 2026 Texas Instruments Incorporated
%YAML 1.2
---
$id: http://devicetree.org/schemas/dma/ti/ti,am62l-dmss-pktdma.yaml#
$schema: http://devicetree.org/meta-schemas/core.yaml#

title: Texas Instruments K3 DMSS PKTDMA V2

maintainers:
  - Sai Sree Kartheek Adivi <s-adivi@ti.com>

description:
  The PKTDMA V2 is intended to perform similar functions as the packet mode
  channels of K3 UDMA-P. PKTDMA V2 only includes Split channels to service
  PSI-L based peripherals.

  The peripherals can be PSI-L native or legacy, non PSI-L native peripherals
  with PDMAs. PDMA is tasked to act as a bridge between the PSI-L fabric and the
  legacy peripheral.

allOf:
  - $ref: /schemas/dma/dma-controller.yaml#

properties:
  compatible:
    const: ti,am62l-dmss-pktdma

  reg:
    items:
      - description: Packet DMA Control & Status
      - description: Channel Realtime
      - description: Ring Realtime

  reg-names:
    items:
      - const: gcfg
      - const: chanrt
      - const: ringrt

  "#dma-cells":
    const: 2
    description: |
      cell 1: Flow ID for the peripheral
        This is the hardware flow index assigned to the peripheral. TX and RX
        flow indices are mixed across the valid range. For XYMF peripherals
        (SPI, CRC32) each chip-select/FIFO has a distinct flow ID; use the
        flow ID for the specific direction and chip-select being requested.

        Please refer to the device documentation for the flow map.

      cell 2: ASEL value for the channel

  interrupts:
    maxItems: 78
    description:
      Interrupts for DMA channels.

  interrupt-names:
    minItems: 78
    maxItems: 78
    items:
      pattern: "^(t|r)x-([0-9]|1[0-3]|1[6-9]|2[0-9]|3[0-9]|4[0-7]|6[4-9]|7[0-9]|9[6-9]|10[0-9]|11[01])$"
    description:
      The name of the interrupt corresponding to the DMA flow.
      TX flows use the "tx-" prefix, RX flows use the "rx-" prefix.

required:
  - compatible
  - reg
  - reg-names
  - "#dma-cells"
  - interrupts
  - interrupt-names

unevaluatedProperties: false

examples:
  - |
    #include <dt-bindings/interrupt-controller/arm-gic.h>
    #include <dt-bindings/interrupt-controller/irq.h>

    dma-controller@485c0000 {
        compatible = "ti,am62l-dmss-pktdma";
        reg = <0x485c0000 0x4000>,
              <0x48900000 0x80000>,
              <0x47200000 0x100000>;
        reg-names = "gcfg", "chanrt", "ringrt";

        #dma-cells = <2>;

        interrupts = <GIC_SPI 354 IRQ_TYPE_LEVEL_HIGH>,
                     <GIC_SPI 355 IRQ_TYPE_LEVEL_HIGH>,
                     <GIC_SPI 358 IRQ_TYPE_LEVEL_HIGH>,
                     <GIC_SPI 359 IRQ_TYPE_LEVEL_HIGH>,
                     <GIC_SPI 362 IRQ_TYPE_LEVEL_HIGH>,
                     <GIC_SPI 363 IRQ_TYPE_LEVEL_HIGH>,
                     <GIC_SPI 366 IRQ_TYPE_LEVEL_HIGH>,
                     <GIC_SPI 367 IRQ_TYPE_LEVEL_HIGH>,
                     <GIC_SPI 370 IRQ_TYPE_LEVEL_HIGH>,
                     <GIC_SPI 371 IRQ_TYPE_LEVEL_HIGH>,
                     <GIC_SPI 374 IRQ_TYPE_LEVEL_HIGH>,
                     <GIC_SPI 375 IRQ_TYPE_LEVEL_HIGH>,
                     <GIC_SPI 378 IRQ_TYPE_LEVEL_HIGH>,
                     <GIC_SPI 379 IRQ_TYPE_LEVEL_HIGH>,
                     <GIC_SPI 322 IRQ_TYPE_LEVEL_HIGH>,
                     <GIC_SPI 323 IRQ_TYPE_LEVEL_HIGH>,
                     <GIC_SPI 322 IRQ_TYPE_LEVEL_HIGH>,
                     <GIC_SPI 323 IRQ_TYPE_LEVEL_HIGH>,
                     <GIC_SPI 322 IRQ_TYPE_LEVEL_HIGH>,
                     <GIC_SPI 323 IRQ_TYPE_LEVEL_HIGH>,
                     <GIC_SPI 322 IRQ_TYPE_LEVEL_HIGH>,
                     <GIC_SPI 323 IRQ_TYPE_LEVEL_HIGH>,
                     <GIC_SPI 326 IRQ_TYPE_LEVEL_HIGH>,
                     <GIC_SPI 327 IRQ_TYPE_LEVEL_HIGH>,
                     <GIC_SPI 326 IRQ_TYPE_LEVEL_HIGH>,
                     <GIC_SPI 327 IRQ_TYPE_LEVEL_HIGH>,
                     <GIC_SPI 326 IRQ_TYPE_LEVEL_HIGH>,
                     <GIC_SPI 327 IRQ_TYPE_LEVEL_HIGH>,
                     <GIC_SPI 326 IRQ_TYPE_LEVEL_HIGH>,
                     <GIC_SPI 327 IRQ_TYPE_LEVEL_HIGH>,
                     <GIC_SPI 330 IRQ_TYPE_LEVEL_HIGH>,
                     <GIC_SPI 331 IRQ_TYPE_LEVEL_HIGH>,
                     <GIC_SPI 330 IRQ_TYPE_LEVEL_HIGH>,
                     <GIC_SPI 331 IRQ_TYPE_LEVEL_HIGH>,
                     <GIC_SPI 330 IRQ_TYPE_LEVEL_HIGH>,
                     <GIC_SPI 331 IRQ_TYPE_LEVEL_HIGH>,
                     <GIC_SPI 330 IRQ_TYPE_LEVEL_HIGH>,
                     <GIC_SPI 331 IRQ_TYPE_LEVEL_HIGH>,
                     <GIC_SPI 334 IRQ_TYPE_LEVEL_HIGH>,
                     <GIC_SPI 335 IRQ_TYPE_LEVEL_HIGH>,
                     <GIC_SPI 334 IRQ_TYPE_LEVEL_HIGH>,
                     <GIC_SPI 335 IRQ_TYPE_LEVEL_HIGH>,
                     <GIC_SPI 334 IRQ_TYPE_LEVEL_HIGH>,
                     <GIC_SPI 335 IRQ_TYPE_LEVEL_HIGH>,
                     <GIC_SPI 334 IRQ_TYPE_LEVEL_HIGH>,
                     <GIC_SPI 335 IRQ_TYPE_LEVEL_HIGH>,
                     <GIC_SPI 500 IRQ_TYPE_LEVEL_HIGH>,
                     <GIC_SPI 501 IRQ_TYPE_LEVEL_HIGH>,
                     <GIC_SPI 502 IRQ_TYPE_LEVEL_HIGH>,
                     <GIC_SPI 503 IRQ_TYPE_LEVEL_HIGH>,
                     <GIC_SPI 504 IRQ_TYPE_LEVEL_HIGH>,
                     <GIC_SPI 505 IRQ_TYPE_LEVEL_HIGH>,
                     <GIC_SPI 506 IRQ_TYPE_LEVEL_HIGH>,
                     <GIC_SPI 507 IRQ_TYPE_LEVEL_HIGH>,
                     <GIC_SPI 508 IRQ_TYPE_LEVEL_HIGH>,
                     <GIC_SPI 509 IRQ_TYPE_LEVEL_HIGH>,
                     <GIC_SPI 510 IRQ_TYPE_LEVEL_HIGH>,
                     <GIC_SPI 511 IRQ_TYPE_LEVEL_HIGH>,
                     <GIC_SPI 512 IRQ_TYPE_LEVEL_HIGH>,
                     <GIC_SPI 513 IRQ_TYPE_LEVEL_HIGH>,
                     <GIC_SPI 514 IRQ_TYPE_LEVEL_HIGH>,
                     <GIC_SPI 515 IRQ_TYPE_LEVEL_HIGH>,
                     <GIC_SPI 484 IRQ_TYPE_LEVEL_HIGH>,
                     <GIC_SPI 485 IRQ_TYPE_LEVEL_HIGH>,
                     <GIC_SPI 486 IRQ_TYPE_LEVEL_HIGH>,
                     <GIC_SPI 487 IRQ_TYPE_LEVEL_HIGH>,
                     <GIC_SPI 488 IRQ_TYPE_LEVEL_HIGH>,
                     <GIC_SPI 489 IRQ_TYPE_LEVEL_HIGH>,
                     <GIC_SPI 490 IRQ_TYPE_LEVEL_HIGH>,
                     <GIC_SPI 491 IRQ_TYPE_LEVEL_HIGH>,
                     <GIC_SPI 492 IRQ_TYPE_LEVEL_HIGH>,
                     <GIC_SPI 493 IRQ_TYPE_LEVEL_HIGH>,
                     <GIC_SPI 494 IRQ_TYPE_LEVEL_HIGH>,
                     <GIC_SPI 495 IRQ_TYPE_LEVEL_HIGH>,
                     <GIC_SPI 496 IRQ_TYPE_LEVEL_HIGH>,
                     <GIC_SPI 497 IRQ_TYPE_LEVEL_HIGH>,
                     <GIC_SPI 498 IRQ_TYPE_LEVEL_HIGH>,
                     <GIC_SPI 499 IRQ_TYPE_LEVEL_HIGH>;
        interrupt-names = "rx-0", "tx-1", "rx-2", "tx-3", "rx-4",
                          "tx-5", "rx-6", "tx-7", "rx-8", "tx-9",
                          "rx-10", "tx-11", "rx-12", "tx-13",
                          "rx-16", "tx-17", "rx-18", "tx-19",
                          "rx-20", "tx-21", "rx-22", "tx-23",
                          "rx-24", "tx-25", "rx-26", "tx-27",
                          "rx-28", "tx-29", "rx-30", "tx-31",
                          "rx-32", "tx-33", "rx-34", "tx-35",
                          "rx-36", "tx-37", "rx-38", "tx-39",
                          "rx-40", "tx-41", "rx-42", "tx-43",
                          "rx-44", "tx-45", "rx-46", "tx-47",
                          "tx-64", "tx-65", "tx-66", "tx-67",
                          "tx-68", "tx-69", "tx-70", "tx-71",
                          "tx-72", "tx-73", "tx-74", "tx-75",
                          "tx-76", "tx-77", "tx-78", "tx-79",
                          "rx-96", "rx-97", "rx-98", "rx-99",
                          "rx-100", "rx-101", "rx-102", "rx-103",
                          "rx-104", "rx-105", "rx-106", "rx-107",
                          "rx-108", "rx-109", "rx-110", "rx-111";
    };
```
